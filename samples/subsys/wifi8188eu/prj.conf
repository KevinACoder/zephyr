## CMakeLists.txt
```
# SPDX-License-Identifier: Apache-2.0
#
# The image is built out of the freewificam module: its `main.c` is the entry
# (console banner, kernel facade, case runner) and its platform library carries
# the CMSIS-RTOS2 backend.  There is therefore no source of this sample's own -
# an application `main()` here would collide with the one the module provides.
#
# The sample exists to pin the configuration: the Kconfig surface of the module
# is three strings, and everything else (the case ladder, the wireless line, the
# USB controller list, the AP identity) comes from the freewificam profile named
# in prj.conf.

cmake_minimum_required(VERSION 3.20.0)

find_package(Zephyr REQUIRED HINTS $ENV{ZEPHYR_BASE})
project(wifi8188eu)

# One translation unit: a build-identity string.  The image's `main()` belongs to
# the freewificam module's platform library (see src/identity.c).
target_sources(app PRIVATE src/identity.c)
```

## prj.conf
```kconfig
# SPDX-License-Identifier: Apache-2.0
#
# 8188EUS (rtl8xxxu) over CherryUSB on the freewificam stack.
#
# The image's content is the freewificam profile named here; the Zephyr side
# only supplies the kernel, the console and the limits the backend needs.  The
# comments state why each Zephyr knob is where it is, because every one of them
# is a condition the backend asserts on rather than something the code adapts to.

# --- the stack ------------------------------------------------------------

CONFIG_FREEWIFICAM=y
# The same ladder the FreeRTOS reference image runs: bring-up, scan, join and
# the raw-L2 data plane, against the same bench AP.
CONFIG_FREEWIFICAM_PROFILE="zephyr-rtl8xxxu-8188eu"
CONFIG_FREEWIFICAM_DRIVER="rtl8xxxu"

# --- kernel shape the backend requires ------------------------------------

# The CMSIS-RTOS2 tick is the millisecond: freewificam's `osDelay(ms)`, its hz
# constant and CherryUSB's timeout conversion are all written against 1 kHz.
# The backend refuses to compile at any other rate.
CONFIG_SYS_CLOCK_TICKS_PER_SEC=1000

# Threads are created at run time with the stack size they ask for (4 KiB to
# 32 KiB), so stacks come from the heap.  Zephyr's own CMSIS-RTOS2 subsystem is
# NOT used - this image does not enable it.  THREAD_STACK_INFO is what
# DYNAMIC_THREAD depends on (it is off by default and Kconfig then drops
# DYNAMIC_THREAD silently, which the backend turns into a compile error).
CONFIG_THREAD_STACK_INFO=y
CONFIG_THREAD_NAME=y
CONFIG_DYNAMIC_THREAD=y
CONFIG_DYNAMIC_THREAD_ALLOC=y

# One arena serves the kernel objects, the driver's buffers and CherryUSB's
# transfers.  The FreeRTOS reference image runs with 16 MiB of heap; the Zephyr
# image has to cover the same working set (32 receive URBs of ~2.3 KiB, the
# stage pool, net80211's node/mbuf allocations, and one stack per thread).
CONFIG_HEAP_MEM_POOL_SIZE=4194304

# The entry thread creates the runner and then parks; the runner's own stack is
# 16 KiB (its cases format lines and run the USB bring-up), which comes from the
# dynamic pool above.  The main thread only needs room for the banner.
CONFIG_MAIN_STACK_SIZE=4096
CONFIG_MAIN_THREAD_PRIORITY=0

# --- interrupts -----------------------------------------------------------

# CherryUSB's controllers are bound at run time from the board's INTID table
# (162/165/201/202), so the vector table has to accept run-time connections.
CONFIG_DYNAMIC_INTERRUPTS=y
CONFIG_GEN_SW_ISR_TABLE=y

# The USB completion path gives a semaphore from the handler; the backend's
# interrupt path never blocks (a nonzero timeout there is reported as an error).
CONFIG_NUM_PREEMPT_PRIORITIES=16
CONFIG_NUM_COOP_PRIORITIES=16

# --- memory and caches ----------------------------------------------------

# The board's MMIO apertures are mapped by the module before USB init; the
# arch's cache maintenance is what CherryUSB's DMA primitives call.
CONFIG_CACHE_MANAGEMENT=y
CONFIG_NOCACHE_MEMORY=y
CONFIG_KERNEL_DIRECT_MAP=y

# The USB domain's ten apertures land in six different 2 MiB blocks
# (0xFC000000, 0xFD000000, 0xFD800000, 0xFDC00000, 0xFDD00000, 0xFE600000), so
# the module's device_map() calls need a table per block plus the upper levels.
# The default of 8 is exhausted by them: the image boots, prints the Zephyr
# banner, and dies in the first SYS_INIT with "CONFIG_MAX_XLAT_TABLES is too
# small" before a single freewificam line appears.
CONFIG_MAX_XLAT_TABLES=64

# --- console --------------------------------------------------------------

# The banner, every anchor and every driver line go through printk(): the
# console must be up before main() and must be legal from an ISR.
CONFIG_PRINTK=y
CONFIG_CONSOLE=y
CONFIG_UART_CONSOLE=y
CONFIG_SERIAL=y
CONFIG_UART_INTERRUPT_DRIVEN=n

# 115200, 8N1 on uart2 (the bench port).  Deliberately no log subsystem: the
# image's own log.c owns the line discipline, the stamp and the anchor
# promotion, and a second formatter would only interleave with it.
CONFIG_LOG=n
CONFIG_SHELL=n

# The image's recovery path (a case that decides the board must come back)
# calls board_system_reset(), which is sys_reboot(SYS_REBOOT_COLD).
CONFIG_REBOOT=y

# --- diagnostics ----------------------------------------------------------

# Assertions stay on: a kernel API misuse in the backend must be visible in the
# same boot, not a silent corruption three cases later.
CONFIG_ASSERT=y
CONFIG_ASSERT_NO_FILE_INFO=y
```

## boards/roc_rk3568_pc.overlay
```dts
/*
 * SPDX-License-Identifier: Apache-2.0
 *
 * Bench wiring of the RK3568 E4AP5G1-ITX board for the 8188EU image.
 *
 * Two things differ from the gmac_bench overlay, and both are load-bearing:
 *
 *  - the console runs at 115200 (the hub's bench port), not the board file's
 *    1.5 Mbaud;
 *  - the SoC's DDR window is 64 MiB, not 1 MiB.  The image carries a 4 MiB heap,
 *    a 16 KiB runner stack, the firmware blob and CherryUSB's pools, and the
 *    Zephyr kernel links its own data/bss into the same region.
 *
 * The USB controllers are NOT described in devicetree.  This Zephyr tree has no
 * USB nodes for RK3568 and the image does not need any: freewificam's board
 * layer owns the controller registers, the PHY/reset sequence and the INTIDs,
 * and the module maps the apertures with device_map() before USB init.  Adding
 * dtsi nodes would duplicate that knowledge in a second place.
 */

/ {
	chosen {
		zephyr,console = &uart2;
		zephyr,shell-uart = &uart2;
	};
};

&uart2 {
	current-speed = <115200>;
	status = "okay";
};

/*
 * The board support declares 1 MiB of SRAM at 0x40000000.  The bench board has
 * 4 GiB of DDR and this image needs far more than 1 MiB, so let Zephyr own the
 * first 64 MiB.
 */
&sram0 {
	reg = <0x40000000 0x04000000>;
};
```

## src/identity.c
```c
/*
 * SPDX-License-Identifier: Apache-2.0
 *
 * The image's entry point is not here.
 *
 * `main()` comes from the freewificam module: it is the stack's own board entry
 * (banner, CMSIS-RTOS2 facade, case-runner thread, scheduler hand-off), compiled
 * into the module's platform library.  A `main()` in this file would be a second
 * definition of the symbol, and the module's is the one whose behaviour the
 * ladder's anchors describe.
 *
 * The file exists because Zephyr's `app` target needs at least one translation
 * unit.  Its content is a build-identity string and nothing else.
 */

#include <zephyr/toolchain.h>

BUILD_ASSERT(CONFIG_FREEWIFICAM, "this image is built around the freewificam module");

__attribute__((used)) static const char fwcam_sample_identity[] =
	"freewificam rtl8xxxu 8188EU over CherryUSB";
```
